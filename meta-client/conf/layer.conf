## meta-client/conf/layer.conf
```bitbake
# We have a conf and classes directory, add to BBPATH
BBPATH .= ":${LAYERDIR}"

# We have recipes-* directories, add to BBFILES
BBFILES += "${LAYERDIR}/recipes-*/*/*.bb \
            ${LAYERDIR}/recipes-*/*/*.bbappend"

BBFILE_COLLECTIONS += "meta-client"
BBFILE_PATTERN_meta-client = "^${LAYERDIR}/"
BBFILE_PRIORITY_meta-client = "6"

LAYERDEPENDS_meta-client = "core"
LAYERSERIES_COMPAT_meta-client = "kirkstone"
```
